/*
 * main.c
 *
 * Created: 5/16/2023 11:13:39 PM
 *  Author: Дима
 */ 

#include <xc.h>
#include <util/delay.h>

int main(void)
{
	DDRD |= (1<<5);
	//int arr[139] = {252,364,396,424,454,482,514,598,630,658,690,776,806,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5376,5410};
	int arr[3] = {252,364,396};
	int i = 0;
	//PORTD |= (1 << 5);
	
	
   while(1){
	   for(int j = 0; j < 3; j++)
	{
		if(j == 0)
		{
			i = abs(0 - arr[j]);
		}
		else
		{
			i = abs(arr[j-1] - arr[j]);
		}
		
		if(j%2 == 0)
		{
			PORTD |= (1 << 5);
			for(int k = 0; k < i/2; k++)
			{
				_delay_us(13.26); //2600
			}
		}
		else
		{
			PORTD &= ~(1 << 5);
			for(int k = 0; k < i; k++)
			{
				_delay_us(7.28); //1400
			}
		}
			
	}
		PORTD &= ~(1 << 5);
		_delay_ms(5000);
		};
}